## TuyaOpen/apps/rgb_cycle_demo/Kconfig
```kconfig
menu "configure app (rgb_cycle_demo)"

config RGB_CYCLE_DEMO
    bool "enable standalone RGB cycle demo"
    default y

endmenu
```

## TuyaOpen/apps/sdcard_demo/Kconfig
```kconfig
menu "configure app (sdcard_demo)"

config SDCARD_DEMO
    bool "enable standalone SD card demo"
    default y

endmenu
```

## TuyaOpen/apps/sensor_display_demo/Kconfig
```kconfig
menu "configure app (sensor_display_demo)"

config SENSOR_DISPLAY_DEMO
    bool "enable sensor display demo"
    default y

endmenu
```
